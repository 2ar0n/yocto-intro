## layers/network-config/conf/layer.conf
```bitbake
# We have a conf and classes directory, add to BBPATH
BBPATH .= ":${LAYERDIR}"

# We have recipes-* directories, add to BBFILES
BBFILES += "${LAYERDIR}/recipes-*/*/*.bb \
            ${LAYERDIR}/recipes-*/*/*.bbappend"

BBFILE_COLLECTIONS += "network-config"
BBFILE_PATTERN_network-config = "^${LAYERDIR}/"
BBFILE_PRIORITY_network-config = "6"

LAYERDEPENDS_network-config = "core"
LAYERSERIES_COMPAT_network-config = "scarthgap"
```

## meta-rp3_custom/conf/distro/aarons-distro.conf
```bitbake
DISTRO = "aarons-distro"
DISTRO_NAME = "My minimal test distro for the raspberypi"
DISTRO_VERSION = "1.0"

PREFERRED_VERSION_linux-raspberrypi ?= "6.12%"
PACKAGE_CLASSES ?= "package_ipk"

DISTRO_FEATURES ?= "ipv4 ipv6 usbhost wifi sysvinit"

INIT_MANAGER = "mdev-busybox"

LICENSE_FLAGS_ACCEPTED = "synaptics-killswitch"

IMAGE_INSTALL:append = " \
    packagegroup-core-boot \
    kernel-modules \
    linux-firmware \
    wpa-supplicant \
    connman \
    connman-client \
    dropbear \
    usbutils \
    psplash \
"
```

## meta-rp3_custom/conf/layer.conf
```bitbake
BBPATH .= ":${LAYERDIR}"
BBFILES += "${LAYERDIR}/recipes-*/*/*.bb \
            ${LAYERDIR}/recipes-*/*/*.bbappend"

BBFILE_COLLECTIONS += "rp3_custom"
BBFILE_PATTERN_rp3_custom = "^${LAYERDIR}/"
BBFILE_PRIORITY_rp3_custom = "10"

LAYERSERIES_COMPAT_rp3_custom = "whinlatter"
LAYERDEPENDS_rp3_custom = "raspberrypi"
```
